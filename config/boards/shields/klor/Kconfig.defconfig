## config/boards/shields/klor/Kconfig.defconfig
```kconfig
if SHIELD_KLOR_LEFT
  config ZMK_KEYBOARD_NAME
    default "KLOR"
  config ZMK_SPLIT_ROLE_CENTRAL
    default y
  endif # LEFT

if SHIELD_KLOR_LEFT || SHIELD_KLOR_RIGHT
  config ZMK_SPLIT
    default y
  endif # LEFT RIGHT

config UART_0_INTERRUPT_DRIVEN
  depends on !ZMK_SPLIT_WIRED_UART_MODE_ASYNC
```

## config/west.yml
```yaml
manifest:
  remotes:
    - name: zmkfirmware
      url-base: https://github.com/zmkfirmware
  projects:
    - name: zmk
      remote: zmkfirmware
      revision: 197f8997776c960b6d2d368909895735f859a4b4  # main
      import: app/west.yml
    - name: zephyr
      remote: zmkfirmware
      revision: 58a5874a446ace2893a196848282d271a551e512  # v4.1.0+zmk-fixes
      import:
        name-blocklist:
          - ci-tools
          - hal_altera
          - hal_cypress
          - hal_infineon
          - hal_microchip
          - hal_nxp
          - hal_openisa
          - hal_silabs
          - hal_xtensa
          - hal_st
          - hal_ti
          - loramac-node
          - mcuboot
          - mcumgr
          - net-tools
          - openthread
          - edtt
          - trusted-firmware-m
  self:
    path: config
```
